 /dts-v1/;  
 /plugin/;  
 
 / {  
   // This determines which boards can use this DTS overlay  
   compatible = "ti,beaglebone", "ti,beaglebone-green", "ti,beaglebone-black";  
   
   // I think part-number is supposed to correspond with the filename,  
   // so we'd save this as "PRU-GPIO-EXAMPLE-00A0.dts".  
   part-number = "PRU-GPIO-EXAMPLE";  
   
   // This always seems to be 00A0, and all the .dtbo files in /lib/firmware  
   // seem to be named foo-00A0.dtbo, but then are loaded without that suffix.  So
   // for foo-00A0.dtbo we'd do 'echo foo > /sys/devices/bone_capemgr.?/slots'
   version = "00A0";
   
   // List the pins and resources we'll be using. This table:  
   // http://elinux.org/Ti_AM33XX_PRUSSv2#Beaglebone_PRU_connections_and_modes  
   // shows which pins can be used with PRU0 and PRU1 for input and output via  
   // registers R31 and R30.  
   // Our output pin, P8_11, corresponds to PRU 0, register 30, bit 15  
   // Our input pin, P8_16, corresponds to PRU 0, register 31, bit 14  
   //  
   // Beware: Many other PRU EGP pins are reserved by HDMI or onboard flash, which  
   // would need to be disabled first by editing uEnv.txt and rebooting.  
   exclusive-use =  
	"P9.27",
	"P9.25",
	"P9.28",
	"P9.29",
	"P9.30",
	"P9.31",
	"P9.41",
	"P9.42",
	"pr1_pru0_pru_r30_5",
	"pr1_pru0_pru_r30_7",
	"pr1_pru0_pru_r30_3",
	"pr1_pru0_pru_r30_1",
	"pr1_pru0_pru_r30_2",
	"pr1_pru0_pru_r30_0",
	"pr1_pru0_pru_r30_6",
	"pr1_pru0_pru_r30_4";
	 
   fragment@0 {  
    target = <&am33xx_pinmux>;  
    __overlay__ {  
      example_pins: pinmux_pru_pru_pins {  
   
       // The offset and mode for pins P8_11 and P8_16 also come from the table linked above.
       //  
       // That table gives offset 0x34 for P8_11, and 0x38 for P8_16.
       // It also shows us we want pinmux mode 6 for P8_11 in output mode,  
       // and again pinmux mode 6 for P8_16 in input mode.
       // 
       // Table 9-60 in the TRM: http://www.ti.com/lit/ug/spruh73l/spruh73l.pdf  
       // helps us calculate the rest of the configuration value.  
       //  
       // For P8_11, the other fields are all 0, so the value is just 0x06.  
       //  
       // For P8_16, we want it to be an input, so we also set bit 5, yielding  
       // a value of 0x26. We could also set bits 3 and 4 to enable a pullup  
       // or pulldown.  

       pinctrl-single,pins = <
	0x1a4 0xd   //pr1_pru0_pru_r30_5 P9.27
	0x1ac 0xd   //pr1_pru0_pru_r30_7 P9.25
	0x19c 0xd   //pr1_pru0_pru_r30_3 P9.28
	0x194 0xd   //pr1_pru0_pru_r30_1 P9.29
	0x198 0xd   //pr1_pru0_pru_r30_2 P9.30
	0x190 0xd   //pr1_pru0_pru_r30_0 P9.31
	0x1b4 0x28  //set input
	0x1a0 0x28  //set input
	0x1a8 0xd   //pr1_pru0_pru_r30_6 P9.41
	0x1a0 0xd   //pr1_pru0_pru_r30_4 P9.42
       >; 
     };  
    };  
   };  
   
   // This enables the PRU and assigns the GPIO pins to it for use in EGP mode.  
   fragment@1 {  
    target = <&pruss>;  
    __overlay__ {  
      status = "okay";  
      pinctrl-names = "default";  
      pinctrl-0 = <&example_pins>;  
    };  
   };  
 };
